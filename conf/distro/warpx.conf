## conf/distro/warpx.conf
```bitbake
require conf/distro/poky.conf

DISTRO_NAME = "warpx.io distribution"

IMAGE_OVERHEAD_FACTOR = "1.1"

PREFERRED_VERSION_swupdate = "git"
```

## conf/layer.conf
```bitbake
# We have a conf and classes directory, add to BBPATH
BBPATH .= ":${LAYERDIR}"

LAYERDEPENDS_warpx = "freescale-layer networking-layer meta-python qt5-layer swupdate"

# We have recipes-* directories, add to BBFILES
BBFILES += "${LAYERDIR}/recipes-*/*/*.bb \
            ${LAYERDIR}/recipes-*/*/*.bbappend"

BBFILE_COLLECTIONS += "warpx"
BBFILE_PATTERN_warpx := "^${LAYERDIR}/"
BBFILE_PRIORITY_warpx = "3"
```

## conf/machine/warp.conf
```bitbake
include conf/machine/imx6sl-warp.conf

# Boot scripts to install
BOOT_SCRIPTS = "boot.scr:boot.scr"

# Ensure boot scripts will be available at rootfs time
do_rootfs[depends] += "u-boot-script-warp:do_deploy"

PREFERRED_PROVIDER_virtual/kernel = "linux-warp"

MACHINE_FIRMWARE += "linux-firmware-warp"
MACHINE_EXTRA_RRECOMMENDS_remove = "bcm4330-nvram-config"

KERNEL_MODULE_AUTOLOAD += " g_multi"
KERNEL_MODULE_PROBECONF += " g_multi"
module_conf_g_multi = "options g_multi removable=y"
```
